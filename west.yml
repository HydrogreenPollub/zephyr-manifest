## west.yml
```yaml
manifest:
  remotes:
    - name: zephyrproject-rtos
      url-base: https://github.com/zephyrproject-rtos
    - name: hydrogreen
      url-base: https://github.com/hydrogreenpollub

  projects:
    - name: zephyr
      remote: zephyrproject-rtos
      revision: main
      import:
        name-allowlist:
          - cmsis_6
          - hal_stm32
          - hal_espressif
          - segger
          - nanopb

    - name: zephyr-can-converter-unit
      remote: hydrogreen
      revision: main
      submodules: true
      path: zephyr-can-converter-unit

    - name: zephyr-lighting-control-unit
      remote: hydrogreen
      revision: main
      submodules: true
      path: zephyr-lighting-control-unit

    - name: zephyr-steering-wheel-unit
      remote: hydrogreen
      revision: main
      submodules: true
      path: zephyr-steering-wheel-unit

    - name: zephyr-fuel-cell-control-unit
      remote: hydrogreen
      revision: main
      submodules: true
      path: zephyr-fuel-cell-control-unit

  self:
    path: zephyr-manifest
```
